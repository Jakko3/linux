## Documentation/devicetree/bindings/mfd/richtek,rt5033.yaml
```yaml
# SPDX-License-Identifier: (GPL-2.0 OR BSD-2-Clause)
%YAML 1.2
---
$id: http://devicetree.org/schemas/mfd/richtek,rt5033.yaml#
$schema: http://devicetree.org/meta-schemas/core.yaml#

title: Richtek RT5033 Power Management Integrated Circuit

maintainers:
  - Jakob Hauser <jahau@rocketmail.com>

description:
  RT5033 is a multifunction device which includes battery charger, fuel gauge,
  flash LED current source, LDO and synchronous Buck converter for portable
  applications. It is interfaced to host controller using I2C interface. The
  battery fuel gauge uses a separate I2C bus.

properties:
  compatible:
    const: richtek,rt5033

  reg:
    maxItems: 1

  interrupts:
    maxItems: 1

  regulators:
    type: object
    $ref: /schemas/regulator/richtek,rt5033-regulator.yaml#

  charger:
    type: object
    $ref: /schemas/power/supply/richtek,rt5033-charger.yaml#

required:
  - compatible
  - reg
  - interrupts

additionalProperties: false

examples:
  - |
    #include <dt-bindings/interrupt-controller/irq.h>

    i2c {
        #address-cells = <1>;
        #size-cells = <0>;

        pmic@34 {
            compatible = "richtek,rt5033";
            reg = <0x34>;

            interrupt-parent = <&msmgpio>;
            interrupts = <62 IRQ_TYPE_EDGE_FALLING>;

            pinctrl-names = "default";
            pinctrl-0 = <&pmic_int_default>;

            regulators {
                safe_ldo_reg: safe_ldo {
                    regulator-name = "safe_ldo";
                    regulator-min-microvolt = <4900000>;
                    regulator-max-microvolt = <4900000>;
                    regulator-always-on;
                };
                ldo_reg: ldo {
                    regulator-name = "ldo";
                    regulator-min-microvolt = <2800000>;
                    regulator-max-microvolt = <2800000>;
                };
                buck_reg: buck {
                    regulator-name = "buck";
                    regulator-min-microvolt = <1200000>;
                    regulator-max-microvolt = <1200000>;
                };
            };

            charger {
                compatible = "richtek,rt5033-charger";
                richtek,pre-microamp = <450000>;
                richtek,fast-microamp = <1000000>;
                richtek,eoc-microamp = <150000>;
                richtek,pre-threshold-microvolt = <3500000>;
                richtek,const-microvolt = <4350000>;
                extcon = <&muic>;
            };
        };
    };
```

## Documentation/devicetree/bindings/power/supply/richtek,rt5033-charger.yaml
```yaml
# SPDX-License-Identifier: (GPL-2.0 OR BSD-2-Clause)
%YAML 1.2
---
$id: http://devicetree.org/schemas/power/supply/richtek,rt5033-charger.yaml#
$schema: http://devicetree.org/meta-schemas/core.yaml#

title: Richtek RT5033 PIMC Battery Charger

maintainers:
  - Jakob Hauser <jahau@rocketmail.com>

description:
  The battery charger of the multifunction device RT5033 has to be instantiated
  under sub-node named "charger" using the following format.

properties:
  compatible:
    const: richtek,rt5033-charger

  richtek,pre-microamp:
    description:
      Current of pre-charge mode. The pre-charge current levels are 350 mA to
      650 mA programmed by I2C per 100 mA.
    maxItems: 1

  richtek,fast-microamp:
    description:
      Current of fast-charge mode. The fast-charge current levels are 700 mA
      to 2000 mA programmed by I2C per 100 mA.
    maxItems: 1

  richtek,eoc-microamp:
    description:
      This property is end of charge current. Its level ranges from 150 mA to
      600 mA. Between 150 mA and 300 mA in 50 mA steps, between 300 mA and 600 mA
      in 100 mA steps.
    maxItems: 1

  richtek,pre-threshold-microvolt:
    description:
      Voltage of pre-charge mode. If the battery voltage is below the pre-charge
      threshold voltage, the charger is in pre-charge mode with pre-charge current.
      Its levels are 2.3 V to 3.8 V programmed by I2C per 0.1 V.
    maxItems: 1

  richtek,const-microvolt:
    description:
      Battery regulation voltage of constant voltage mode. This voltage levels from
      3.65 V to 4.4 V by I2C per 0.025 V.
    maxItems: 1

  extcon:
    description:
      Phandle to the extcon device.
    maxItems: 1

required:
  - richtek,pre-microamp
  - richtek,fast-microamp
  - richtek,eoc-microamp
  - richtek,pre-threshold-microvolt
  - richtek,const-microvolt

additionalProperties: false

examples:
  - |
    charger {
        compatible = "richtek,rt5033-charger";
        richtek,pre-microamp = <450000>;
        richtek,fast-microamp = <1000000>;
        richtek,eoc-microamp = <150000>;
        richtek,pre-threshold-microvolt = <3500000>;
        richtek,const-microvolt = <4350000>;
        extcon = <&muic>;
    };
```
